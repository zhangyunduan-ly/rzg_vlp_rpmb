## build-minimal-flash/conf/bblayers.conf
```bitbake
# POKY_BBLAYERS_CONF_VERSION is increased each time build/conf/bblayers.conf
# changes incompatibly
POKY_BBLAYERS_CONF_VERSION = "2"

BBPATH = "${TOPDIR}"
BBFILES ?= ""

BBLAYERS ?= " \
  ${TOPDIR}/../poky/meta \
  ${TOPDIR}/../poky/meta-poky \
  ${TOPDIR}/../poky/meta-yocto-bsp \
  ${TOPDIR}/../meta-openembedded/meta-oe \
  ${TOPDIR}/../meta-openembedded/meta-python \
  ${TOPDIR}/../meta-openembedded/meta-multimedia \
  ${TOPDIR}/../meta-arm/meta-arm-toolchain \
  ${TOPDIR}/../meta-arm/meta-arm \
  ${TOPDIR}/../meta-renesas/meta-rz-bsp \
  ${TOPDIR}/../meta-renesas/meta-rz-distro \
  ${TOPDIR}/../meta-rz-features/meta-rz-security \
  ${TOPDIR}/../meta-ly \
  /home/renesas/rz/rzg_vlp_rpmb/build-minimal-flash/workspace \
  "
```

## meta-ly/conf/layer.conf
```bitbake
# We have a conf and classes directory, add to BBPATH
BBPATH .= ":${LAYERDIR}"

# We have recipes-* directories, add to BBFILES
BBFILES += "${LAYERDIR}/recipes-*/*/*.bb \
            ${LAYERDIR}/recipes-*/*/*.bbappend"

BBFILE_COLLECTIONS += "meta-ly-core"
BBFILE_PATTERN_meta-ly-core = "^${LAYERDIR}/"
BBFILE_PRIORITY_meta-ly-core = "20"

LAYERDEPENDS_meta-ly-core = "core"
LAYERSERIES_COMPAT_meta-ly-core = "scarthgap"
```

## meta-renesas/meta-rz-bsp/conf/machine/ly-rzg2ul.conf
```bitbake
#@TYPE: Machine
#@NAME: ly-rzg2ul machine
#@DESCRIPTION: RZ/G2UL LY platform

require conf/machine/include/arm/armv8-2a/tune-cortexa55.inc
require conf/machine/include/rz-common.inc
require conf/machine/include/rzg2l-family.inc

# Trusted Firmware-A configuration
PREFERRED_VERSION_trusted-firmware-a ?= "2.9%"
TFA_PLATFORM ?= "g2ul"
TFA_BOARD ?= "g2ul_ly"
TFA_UBOOT ?= "1"
TFA_BUILD_TARGET ?= "bl2 bl31 fip"
BL2_BOOT_TARGET ?= "spi mmc esd"
BL2_ADJUST_VMA ?= "0x00011E00"
FIP_ADJUST_VMA ?= "0x0000"

# U-Boot Configuration
UBOOT_CONFIG ??= "ly-rzg2ul"
UBOOT_CONFIG[ly-rzg2ul] = "ly-rzg2ul_defconfig"
PREFERRED_VERSION_u-boot = "2021.10%"

# Linux kernel configuration
KERNEL_DEVICETREE = "renesas/ly-rzg2ul.dtb"

# Flash Writer configuration
FLASH_WRITER_BOARD ?= "RZG2UL_LY"

# Wic image
WKS_FILE = "rz-image-bootpart-esd.wks"

IMAGE_BOOT_FILES = " \
	bl2_bp_spi-${MACHINE}.bin \
	bl2_bp_mmc-${MACHINE}.bin \
	fip-${MACHINE}.bin \
	bl2_bp_spi-${MACHINE}.srec \
	bl2_bp_mmc-${MACHINE}.srec \
	fip-${MACHINE}.srec \
	Flash_Writer_SCIF_RZG2UL_LY_DDR4_1GB_1PCS.mot \
"
do_image_wic[depends] += "firmware-pack:do_deploy flash-writer:do_deploy"
```

## meta-rz-features/meta-rz-security/conf/layer.conf
```bitbake
# We have a conf and classes directory, add to BBPATH
BBPATH .= ":${LAYERDIR}"

# We have recipes-* directories, add to BBFILES
BBFILES += "${LAYERDIR}/recipes-*/*/*.bb \
	    ${LAYERDIR}/recipes-*/*/*.bbappend \
	    ${LAYERDIR}/recipes-*/*.bb \
	    ${LAYERDIR}/recipes-*/*.bbappend"

BBFILE_COLLECTIONS += "rz-security"
BBFILE_PATTERN_rz-security := "^${LAYERDIR}/"

LAYERDEPENDS_rz-security = "meta-rz-bsp"
LAYERSERIES_COMPAT_rz-security = "scarthgap"

require ${LAYERDIR}/include/security-config.inc
include ${LAYERDIR}/wic/rz-image-bootpart-esd.inc
```

## meta-rz-features/meta-rz-security/wic/rz-image-bootpart-esd_tbb-rzg2ul-rzg2lc.wks
```
# Short-description: Create image for eMMC
# Long-description: Creates a image that can be used to write to eMMC for RZ boards
#                   First partition contains files of bootloader and related components
#                   Second partition contains rootfs, as well as Linux image and devicetree
#                   Note: the bootloader in first partition cannot be used for eMMC boot. In eMMC boot
#                         user has to manually write the bootloader to mmcblk0boot0.

part --source rawcopy --sourceparams="file=bl2-tbb_bp_esd-${MACHINE}.bin" --no-table
part --source rawcopy --sourceparams="file=bl2-tbb_${MACHINE}.bin" --no-table --offset 8s --align 4
part --source rawcopy --sourceparams="file=fip-tbb-${MACHINE}.bin" --no-table --offset 128s --align 64

part --source bootimg-partition --fstype=vfat --label bootloader --align 2048
part --source rootfs            --fstype=ext4 --label root            --align 4
```
